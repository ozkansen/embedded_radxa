## machine/rock5a/conf/bblayers.conf
```bitbake
# POKY_BBLAYERS_CONF_VERSION is increased each time build/conf/bblayers.conf
# changes incompatibly
POKY_BBLAYERS_CONF_VERSION = "2"

BBPATH = "${TOPDIR}"
BBFILES ?= ""

BBLAYERS ?= " \
  /home/duyurubu/embedded_radxa/sources/poky/meta \
  /home/duyurubu/embedded_radxa/sources/poky/meta-poky \
  /home/duyurubu/embedded_radxa/sources/poky/meta-yocto-bsp \
  "
```
